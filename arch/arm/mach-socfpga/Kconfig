## arch/arm/mach-socfpga/Kconfig
```kconfig
config FPGA_SDRAM
	bool "Enables FPGA SDRAM"
	depends on ARCH_SOCFPGA
	help
		This enables the SDRAM controller that is connected to the FGPA.
```

## drivers/irqchip/Kconfig
```kconfig
config IRQCHIP
	def_bool y
	depends on OF_IRQ

config RENESAS_INTC_IRQPIN
	bool
	select IRQ_DOMAIN

config RENESAS_IRQC
	bool
	select IRQ_DOMAIN
```

## fs/axfs/Kconfig
```kconfig
config AXFS
	tristate "Advanced XIP File System (AXFS) support (EXPERIMENTAL)"
	select FS_XIP
	select ZLIB_INFLATE
	help
	  The Advanced XIP File System or (AXFS) is a highly compressed
	  readonly filesystem like cramfs or squashfs.  It also can be
	  configured to store individual pages of files compressed or
	  uncompressed as XIP pages.  This allows for faster boot up and
	  application launch time with a smaller memory footprint.

config AXFS_PROFILING
	bool "Profiling extensions for AXFS (EXPERIMENTAL)"
	depends on AXFS
	help
	  Profiling tooling used to identify what pages in the filesystem
	  image are actually accessed and how much.

config AXFS_DEBUG
	bool "AXFS debugging support"
	depends on AXFS
	help
	  If you are experiencing any problems with the AXFS filesystem, say
	  Y here.  This will create a profile entry at /proc/axfs_xip. In this
	  profile, the XIP mapped pages of files are recorded.

	  If unsure, say N.

config AXFS_DEBUG_XIP_RECORDS_NUM
	int "Number of axfs xip profile records (100 - 1000)"
	range 100 1000
	depends on AXFS_DEBUG
	default 500
	help
	  The number of records which /porc/axfs_xip can record. one record
	  takes about 64 bytes of memory.
```

## net/bus/Kconfig
```kconfig
#
# Bus Domain Sockets
#

config AF_BUS
	tristate "Bus domain sockets (EXPERIMENTAL)"
	depends on EXPERIMENTAL
	---help---
	  If you say Y here, you will include support for Bus domain sockets.
	  These sockets are used to create communication buses for IPC.

	  To compile this driver as a module, choose M here: the module will be
	  called bus.

	  Say N unless you know what you are doing.

source "net/bus/nfdbus/Kconfig"
```

## net/bus/nfdbus/Kconfig
```kconfig
#
# Netfilter D-Bus module configuration
#
config NETFILTER_DBUS
	tristate "Netfilter D-bus (EXPERIMENTAL)"
	depends on AF_BUS && CONNECTOR && EXPERIMENTAL
	---help---
	  If you say Y here, you will include support for a netfilter hook to
	  parse D-Bus messages sent using the AF_BUS socket address family.

	  To compile this as a module, choose M here: the module will be
	  called netfilter_dbus.
```
